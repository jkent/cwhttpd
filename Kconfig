## Kconfig
```kconfig
#ESP-IDF Kconfig configuration file.
menu "Clockwise HTTPd"

choice
	prompt "Log level"
	default CWHTTPD_LOG_LEVEL_WARNING

config CWHTTPD_LOG_LEVEL_NONE
	bool "None"

config CWHTTPD_LOG_LEVEL_ERROR
	bool "Error"

config CWHTTPD_LOG_LEVEL_WARNING
	bool "Warning"

config CWHTTPD_LOG_LEVEL_INFO
	bool "Info"

config CWHTTPD_LOG_LEVEL_DEBUG
	bool "Debug"

config CWHTTPD_LOG_LEVEL_VERBOSE
	bool "Verbose"

endchoice # "Log level"

config CWHTTPD_LISTENER_STACK_SIZE
	int "Listener task stack size"
	range 0 65535
	default 2048
	help
		Stack size reserved for the listener task.

config CWHTTPD_LISTENER_PRIORITY
	int "Listener task priority"
	range 1 31
	default 1
	help
		Set the listener task priority.

config CWHTTPD_LISTENER_AFFINITY
	int "Listener task processor affinity"
	depends on IDF_TARGET_ESP32 || IDF_TARGET_ESP32S3
	range -1 1
	default -1
	help
		For the listener task, select -1 to disable task pinning,
		0 for PRO_CPU, and 1 for APP_CPU.

config CWHTTPD_LISTENER_BACKLOG
	int "Listener backlog"
	range 1 64
	default 2
	help
		How many connections that can be waiting in the listen queue.

config CWHTTPD_WORKER_STACK_SIZE
	int "Worker task stack size"
	range 0 65535
	default 4096
	help
		Stack size reserved for worker tasks. This includes route handlers.

config CWHTTPD_WORKER_PRIORITY
	int "Worker task priority"
	range 1 31
	default 1
	help
		Set the worker task priority.

config CWHTTPD_WORKER_AFFINITY
	int "Worker task processor affinity"
	depends on IDF_TARGET_ESP32 || IDF_TARGET_ESP32S3
	range -1 1
	default -1
	help
		For the worker task, select -1 to disable task pinning,
		0 for PRO_CPU, and 1 for APP_CPU.

config CWHTTPD_WORKER_COUNT
	int "Number of worker tasks"
	range 1 64
	default 2
	help
		Set the number of worker tasks to run.

config CWHTTPD_MAX_REQUEST_SIZE
	int "Max length of request headers"
	default 1024
	help
	    This is statically allocated per connection.

config CWHTTPD_DEFAULT_CLOSE
	bool "Default to closing connections"
	default n

config CWHTTPD_ENABLE_CORS
	bool "Enable CORS support"
	default n

if CWHTTPD_ENABLE_CORS

config CWHTTPD_CORS_ORIGIN
	string "CORS origin"
	default "*"
	help
		CORS allowed origin.

config CWHTTPD_CORS_METHODS
	string "CORS methods"
	default "GET,PUT,POST,DELETE,OPTIONS"
	help
		CORS allowed HTTP methods.

endif # CWHTTPD_ENABLE_CORS

config CWHTTPD_TCP_NODELAY
	bool "Set TCP_NODELAY"
	default n
	help
		Set TCP_NODELAY to avoid waiting for a ACK to send multiple small
		frames (It will disable Nagle's TCP Algorithm).  It can speed-up
		transfers for small files.

config CWHTTPD_MBEDTLS
	bool "Enable MBedTLS"
	default n
	help
		Enabling this allows HTTP instances to be configured for serving
		TLS connections.

endmenu
```
